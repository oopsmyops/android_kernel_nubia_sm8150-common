## drivers/nubia/Kconfig
```kconfig
#
# Nubia drivers configuration
#

#menuconfig NUBIA_DRIVERS
menu "nubia drivers"

config NUBIA_DRIVERS
	bool "NUBIA DRIVERS"
	default y
	help
	  Say Y here if you want to enable NUBIA DRIVERS
	  If unsure, say N.

comment "Nubia Device Drivers"

if NUBIA_DRIVERS
# Add nubia drivers configuration here

config NUBIA_TOUCHSCREENS
	bool "NUBIA_TOUCHSCREENS"
	depends on NUBIA_DRIVERS
	default n
	help
	  Say Y here if you want to enable NUBIA_TOUCHSCREENS
	  If unsure, say N.

if NUBIA_TOUCHSCREENS
source "drivers/nubia/touch/Kconfig"
endif

config NUBIA_FINGERPRINT
	bool "NUBIA_FINGERPRINT"
	default y
	help
	 Say Y here if you have enable NUBIA_FINGERPRINT
	 IF  unsure ,say N

config NUBIA_TOUCH
        bool "NUBIA_TOUCH"
        default y
        help
         Say Y here if you have enable NUBIA_TOUCH
         IF  unsure ,say N

endif


if NUBIA_FINGERPRINT
source "drivers/nubia/fingerprint/Kconfig"
endif

config NUBIA_SENSORS
	boolean "Nubia sensor controller"
	boolean "Nubia sensor controller"
	bool "NUBIA_SENSORS"
	depends on NUBIA_DRIVERS
	default n
	help
	  Say Y here if you don't want to enable NUBIA_SENSORS
	  If unsure, say N.

if NUBIA_SENSORS
source drivers/nubia/sensors/Kconfig
endif

if NUBIA_TOUCH
source "drivers/nubia/touch/Kconfig"
endif

endmenu

# Nubia configuration options

 config MACH_NUBIA
    bool "NUBIA device"
    depends on ARCH_QCOM
    help
      Support for Nubia products

 config MACH_NUBIA_SM8150
    bool "NUBIA SM8150"
    depends on ARCH_SM8150
    select MACH_NUBIA
    help
      Support for SM8150 / SDM855 Nubia variants

 menu "Nubia board selection"

 config MACH_NUBIA_NX627H
    bool "NUBIA_NX627H board"
    select MACH_NUBIA_SM8150
    help
      Support for Nubia Z20 variant (1)

 config MACH_NUBIA_NX627J
    bool "NUBIA_NX627J board"
    select MACH_NUBIA_SM8150
    help
      Support for Nubia Z20 variant (2)

 config MACH_NUBIA_NX629J
    bool "NUBIA_NX629J board"
    select MACH_NUBIA_SM8150
    help
      Support for Nubia Red Magic 3 

 config MACH_NUBIA_NX639J
    bool "NUBIA_NX639J board"
    select MACH_NUBIA_SM8150
    help
      Support for Nubia NX639J variant (unknown device) 
      
 config MACH_NUBIA_TP1803
    bool "NUBIA_TP1803 board"
    select MACH_NUBIA_SM8150
    help
      Support for Nubia Mini 5G variant

 endmenu
```
